#include "24LC01-RK.h"

// Low-level test of 24LC01 I2C EEPROM driver

SYSTEM_THREAD(ENABLED);
SYSTEM_MODE(MANUAL);

SerialLogHandler logHandler(LOG_LEVEL_TRACE);

// This is more data than we need for the 24LC01. It's 128 bytes, and this is 1024 bytes of random data.
static const uint8_t randomData[] = {
		0xa7, 0xf1, 0xd9, 0x2a, 0x82, 0xc8, 0xd8, 0xfe, 0x43, 0x4d, 0x98, 0x55, 0x8c, 0xe2, 0xb3, 0x47, 0x17, 0x11, 0x98, 0x54, 0x2f, 0x11, 0x2d, 0x05, 0x58, 0xf5, 0x6b, 0xd6, 0x88, 0x07, 0x99, 0x92,
		0x48, 0x33, 0x62, 0x41, 0xf3, 0x0d, 0x23, 0xe5, 0x5f, 0x30, 0xd1, 0xc8, 0xed, 0x61, 0x0c, 0x4b, 0x02, 0x35, 0x39, 0x81, 0x84, 0xb8, 0x14, 0xa2, 0x9c, 0xb4, 0x5a, 0x67, 0x2a, 0xca, 0xe5, 0x48,
		0xe9, 0xc5, 0xf1, 0xb0, 0xc4, 0x15, 0x8a, 0xe5, 0x9b, 0x4d, 0x39, 0xf6, 0xf7, 0xe8, 0xa1, 0x05, 0xd3, 0xfe, 0xed, 0xa5, 0xd5, 0xf3, 0xd9, 0xe4, 0x5b, 0xfa, 0x6c, 0xc3, 0x51, 0xe2, 0x20, 0xae,
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		0x62, 0x1f, 0x14, 0x97, 0xb0, 0x85, 0xcf, 0x8e, 0x99, 0x9d, 0x98, 0x6e, 0xf8, 0xff, 0x3a, 0x88, 0x9a, 0x02, 0x38, 0x97, 0x99, 0x83, 0xa8, 0x68, 0x6f, 0x69, 0xe1, 0x0e, 0xf9, 0x24, 0x9a, 0x87
};

EEPROM_24LC01 eeprom;
uint8_t tempBuf[128];
uint8_t savedData[128];

void runSimpleTest();
void runLargeTest();

void setup() {
	eeprom.begin();
}

void loop() {
	delay(15000);
	runSimpleTest();
	runLargeTest();
}


const char *fishNames[] = {"Aeneus corydoras", "African glass catfish", "African lungfish", "Aholehole",
		"Airbreathing catfish", "Airsac catfish", "Alaska blackfish", "Albacore",
		"Alewife", "Alfonsino", "Algae eater", "Alligatorfish",
		"Alligator gar", "American sole", "Amur pike", "Anchovy"};

typedef struct {
	int a;
	float b;
	bool c;
} SimpleStruct;


void runSimpleTest() {
	// Low-level
	bool bResult;
	uint32_t d1;
	eeprom.readData(0, (uint8_t *)&d1, sizeof(d1));
	Log.trace("d1=%lu", d1);

	d1++;
	bResult = eeprom.writeData(0, (const uint8_t *)&d1, sizeof(d1));
	if (!bResult) {
		Log.error("** %d: call returned false", __LINE__);
	}

	uint32_t d2;
	eeprom.readData(0, (uint8_t *)&d2, sizeof(d2));
	if (!bResult) {
		Log.error("** %d: call returned false", __LINE__);
	}
	if (d1 != d2) {
		Log.error("** %d: %lu != %lu", __LINE__, d1, d2);
	}

	// EEPROM-style API
	// Note that you can substitute EEPROM for the eeprom in the get and put calls and this code will
	// work identically with the EEPROM emulation on the Photon/Electron.
	int addr = 4;
	int intVal;

	// int
	{
		// You can get and put simple values like int, long, bool, etc. using get and put directly

		eeprom.get(addr, intVal);
		Log.trace("addr=%d, intVal=%d, sizeof(int)=%d", addr, intVal, sizeof(int));

		intVal++;
		eeprom.put(addr, intVal);

		int intVal2;
		eeprom.get(addr, intVal2);

		if (intVal != intVal2) {
			Log.error("** %d: %d != %d", __LINE__, intVal, intVal2);
		}


		addr += sizeof(int);
	}
	// double
	{
		double doubleVal;

		// Same for float, double
		eeprom.get(addr, doubleVal);
		Log.trace("addr=%d, doubleVal=%lf, sizeof(doubleVal)=%d", addr, doubleVal, sizeof(doubleVal));

		doubleVal += 0.1;
		eeprom.put(addr, doubleVal);

		double doubleVal2;
		eeprom.get(addr, doubleVal2);

		if (doubleVal != doubleVal2) {
			Log.error("** %d: %lf != %lf", __LINE__, doubleVal, doubleVal2);
		}

		addr += sizeof(doubleVal);
	}

	// Strings are a bit more of a pain because you have to know how much space you want to reserve.
	// In this example, we store a string of up to 15 characters, plus a null byte, in a 16 character buffer
	{
		const int STRING_BUF_SIZE = 16;
		char stringBuf[STRING_BUF_SIZE];

		eeprom.get(addr, stringBuf);
		stringBuf[sizeof(stringBuf) - 1] = 0; // make sure it's null terminated

		// Initialize a String object from the buffer
		String str(stringBuf);

		Log.trace("addr=%d, str=%s, sizeof(stringBuf)=%d", addr, str.c_str(), sizeof(stringBuf));

		str = String(fishNames[intVal & 0xf]);
		Log.trace("next fish name=%s", str.c_str());

		// getBytes handles truncating the string if it's longer than the buffer.
		str.getBytes((unsigned char *)stringBuf, sizeof(stringBuf));
		eeprom.put(addr, stringBuf);

		char stringBuf2[STRING_BUF_SIZE];

		eeprom.get(addr, stringBuf2);
		stringBuf2[sizeof(stringBuf2) - 1] = 0; // make sure it's null terminated

		if (strcmp(stringBuf, stringBuf2) != 0) {
			Log.error("** %d: %s != %s", __LINE__, stringBuf, stringBuf2);
		}

		addr += sizeof(stringBuf);
	}

	// A simple structure
	{
		SimpleStruct data;

		// You can even store a small structure of values
		eeprom.get(addr, data);
		Log.trace("addr=%d, a=%d b=%f c=%d, sizeof(data)=%d", addr, data.a, data.b, data.c, sizeof(data));

		data.a += 2;
		data.b += 0.02;
		data.c = !data.c;

		eeprom.put(addr, data);
		Log.trace("after put addr=%d, a=%d b=%f c=%d, sizeof(data)=%d", addr, data.a, data.b, data.c, sizeof(data));

		SimpleStruct data2;
		eeprom.get(addr, data2);
		Log.trace("after read addr=%d, a=%d b=%f c=%d, sizeof(data)=%d", addr, data2.a, data2.b, data2.c, sizeof(data2));

		if (data.a != data2.a) {
			Log.error("** %d: %d != %d", __LINE__, data.a, data2.a);
		}
		if (data.b != data2.b) {
			Log.error("** %d: %lf != %lf", __LINE__, data.b, data2.b);
		}
		if (data.c != data2.c) {
			Log.error("** %d: %d != %d", __LINE__, data.c, data2.c);
		}


		addr += sizeof(data);
	}
	Log.info("runSimpleTest completed");
}

void runLargeTest() {
	bool bResult;

	bResult = eeprom.readData(0, savedData, sizeof(savedData));
	if (!bResult) {
		Log.error("** %d: failed", __LINE__);
	}


	// Test cross-block write
	bResult = eeprom.writeData(4, randomData, 16);
	if (!bResult) {
		Log.error("** %d: failed", __LINE__);
	}

	bResult = eeprom.readData(4, tempBuf, 16);
	if (!bResult) {
		Log.error("** %d: failed", __LINE__);
	}

	for(size_t ii = 0; ii < 16; ii++) {
		if (randomData[ii] != tempBuf[ii]) {
			Log.error("** %d: failed ii=%u %u != %u", __LINE__, ii, randomData[ii], tempBuf[ii]);
		}
	}

	// Write whole thing
	bResult = eeprom.writeData(0, randomData, sizeof(tempBuf));
	if (!bResult) {
		Log.error("** %d: failed", __LINE__);
	}

	bResult = eeprom.readData(0, tempBuf, sizeof(tempBuf));
	if (!bResult) {
		Log.error("** %d: failed", __LINE__);
	}

	for(size_t ii = 0; ii < sizeof(tempBuf); ii++) {
		if (randomData[ii] != tempBuf[ii]) {
			Log.error("** %d: failed ii=%u %02x != %02x", __LINE__, ii, randomData[ii], tempBuf[ii]);
			break;
		}
	}

	// Erase
	bResult = eeprom.erase();
	if (!bResult) {
		Log.error("** %d: failed", __LINE__);
	}

	bResult = eeprom.readData(0, tempBuf, sizeof(tempBuf));
	if (!bResult) {
		Log.error("** %d: failed", __LINE__);
	}

	for(size_t ii = 0; ii < sizeof(tempBuf); ii++) {
		if (tempBuf[ii] != 0) {
			Log.error("** %d: failed ii=%d %02x != 0", __LINE__, ii, tempBuf[ii]);
			break;
		}
	}

	bResult = eeprom.writeData(0, savedData, sizeof(savedData));
	if (!bResult) {
		Log.error("** %d: failed", __LINE__);
	}

	Log.info("runLargeTest completed");

}

